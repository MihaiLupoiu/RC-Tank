## components/mod_mobile_controller/Kconfig.projbuild
```kconfig
menu "Mobile Controller Configuration"

    config ESP_MOBILE_CONTROLLER_MQTT_TOPIC
        string "Mobile Controller MQTT topic"
        default "tank.1"
        help
            Topic used in the Mobile Controller application to send commands.

endmenu
```

## components/mod_mqtt/Kconfig.projbuild
```kconfig
menu "MQTT Configuration"

    config BROKER_URL
        string "Broker URL"
        default "mqtt://mqtt.lupoiu.com"
        help
            URL of the broker to connect to

endmenu
```

## components/mod_wifi/Kconfig.projbuild
```kconfig
menu "WiFi Configuration"

    config ESP_WIFI_SSID
        string "WiFi SSID"
        default "myssid"
        help
            SSID (network name) for the example to connect to.

    config ESP_WIFI_PASSWORD
        string "WiFi Password"
        default "mypassword"
        help
            WiFi password (WPA or WPA2) for the example to use.
    
    config ESP_WIFI_MAX_RECONNECTION_TIME
        int "MAX_RECONNECTION"
        default 60
        help
           Max reconnection time

endmenu
```
